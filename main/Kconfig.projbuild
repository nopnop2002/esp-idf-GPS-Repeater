## main/Kconfig.projbuild
```kconfig
menu "Application Configuration"

	config GPIO_RANGE_MAX
		int
		default 33 if IDF_TARGET_ESP32
		default 46 if IDF_TARGET_ESP32S2
		default 48 if IDF_TARGET_ESP32S3
		default 18 if IDF_TARGET_ESP32C2
		default 19 if IDF_TARGET_ESP32C3
		default 30 if IDF_TARGET_ESP32C6

	config UART_RXD_GPIO
		int "GPS RX GPIO number"
		range 0 GPIO_RANGE_MAX
		default 16 if IDF_TARGET_ESP32
		default  1 if IDF_TARGET_ESP32S2 || IDF_TARGET_ESP32S3
		default  0 # C3 and others
		help
			GPIO number (IOxx) for GPS RXD.
			Some GPIOs are used for other purposes (flash connections, etc.) and cannot be used to RXD.

	choice TRANSFER
		prompt "Transfer mode"
		default TCP_SOCKET
		help
			Select trasnfer mode.
		config TCP_SOCKET
			bool "TCP Socket"
			help
				ESP32 runs as TCP Server.
		config UDP_BROADCAST
			bool "UDP Broadcast"
			help
				ESP32 runs as UDP Server.
		config BLUETOOTH_SPP
			depends on IDF_TARGET_ESP32
			bool "Classic Bluetooth SPP Acceptor"
			help
				ESP32 runs as SPP Acceptor.
	endchoice

	config SERVER_PORT
		depends on TCP_SOCKET
		int "Port number of TCP Server"
		default 5000
		help
			Port number of TCP Server.
			u-centet connect to this port.

	config BROADCAST_PORT
		depends on UDP_BROADCAST
		int "Port number of UDP Broadcast"
		default 9000
		help
			Port number of UDP Broadcast.

	choice WIFI_MODE
		depends on TCP_SOCKET || UDP_BROADCAST
		prompt "Wi-Fi Access mode"
		default STA_MODE
		help
			Select Wi-Fi Access mode.
		config STA_MODE
			bool "Station MODE"
			help
				Wi-Fi is Station Mode.
		config AP_MODE
			bool "Access Point MODE"
			help
				Wi-Fi is Access Point Mode.
	endchoice

	config ESP_WIFI_SSID
		depends on TCP_SOCKET || UDP_BROADCAST
		string "WiFi SSID"
		default "myssid"
		help
			SSID (network name) for the example to connect to.

	config ESP_WIFI_PASSWORD
		depends on TCP_SOCKET || UDP_BROADCAST
		string "WiFi Password"
		default "mypassword"
		help
			WiFi password (WPA or WPA2) for the example to use.

	config ESP_MAX_STA_CONN
		depends on AP_MODE
		int "Maximum STA connections"
		default 4
		help
			Max number of the STA connects to AP.

	config ESP_MAXIMUM_RETRY
		depends on STA_MODE
		int "Maximum retry"
		default 5
		help
			Set the Maximum retry to avoid station reconnecting to the AP unlimited when the AP is really inexistent.

	config MDNS_HOSTNAME
		depends on STA_MODE
		string "mDNS Hostname"
		default "esp32-server"
		help
			mDNS Hostname for example to use

	config STATIC_IP
		depends on STA_MODE
		bool "Enable Static IP Address"
		default false
		help
			Enable Static IP Address.

	config STATIC_IP_ADDRESS
		depends on STATIC_IP
		string "Static IP Address"
		default "192.168.10.100"
		help
			Static IP Address for Station.

	config STATIC_GW_ADDRESS
		depends on STATIC_IP
		string "Static GW Address"
		default "192.168.10.1"
		help
			Static GW Address for Station.

	config STATIC_NM_ADDRESS
		depends on STATIC_IP
		string "Static Netmask"
		default "255.255.255.0"
		help
			Static Netmask for Station.

endmenu
```
